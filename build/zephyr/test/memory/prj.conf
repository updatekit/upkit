## CMakeLists.txt
```
cmake_minimum_required(VERSION 3.11)
include($ENV{ZEPHYR_BASE}/cmake/app/boilerplate.cmake NO_POLICY_SCOPE)
project(test_memory)

target_sources(app PRIVATE src/main.c)

set(ROOTDIR "../../../..")

# Add libpull to the build
file(GLOB libpull_src ${ROOTDIR}/src/**/**/*.c)
file(GLOB libpull_headers ${ROOTDIR}/include)
target_sources(app PRIVATE ${libpull_src})
include_directories(${libpull_headers})

add_definitions(-DSIMPLE_MANIFEST=1 -DLOGGER_VERBOSITY=3)
add_definitions(-DMEMORY_FLASH_IMPL=1 -DDISABLE_LIBPULL_NETWORK=1 -DWITH_PLATFORM_NRF52840=1)

# Add the board files
set(BOARDDIR ${ROOTDIR}/src/platform/nrf52840)
include_directories(${BOARDDIR})
include_directories(${ROOTDIR}/test/platform)
file(GLOB board_src ${BOARDDIR}/*.c)
target_sources(app PRIVATE ${board_src})
```

## prj.conf
```kconfig
CONFIG_DEBUG=y

CONFIG_BT=n

CONFIG_NEWLIB_LIBC=y
CONFIG_STDOUT_CONSOLE=y

CONFIG_FLASH=y
CONFIG_FLASH_PAGE_LAYOUT=y
CONFIG_MPU_ALLOW_FLASH_WRITE=y
```

## src/main.c
```c
#include <stdio.h>
#include <string.h>

#include "memory.h"

int main(void) {
    nTEST_INIT();
    nTEST_RUN(test_memory);
    nTEST_END();
    return 0;
}
```

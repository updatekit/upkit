## CMakeLists.txt
```
cmake_minimum_required(VERSION 3.11)
include($ENV{ZEPHYR_BASE}/cmake/app/boilerplate.cmake NO_POLICY_SCOPE)
project(test_network)

target_sources(app PRIVATE src/main.c)

set(ROOTDIR "../../../..")

# Add libpull to the build
file(GLOB libpull_src ${ROOTDIR}/src/**/**/*.c)
file(GLOB libpull_headers ${ROOTDIR}/include)
target_sources(app PRIVATE ${libpull_src})
include_directories(${libpull_headers} ${ROOTDIR})

set(BOARDDIR ${ROOTDIR}/src/platform/nrf52840)
file(GLOB BOARDSRC ${BOARDDIR}/*.c)
target_sources(app PRIVATE ${BOARDSRC})
include_directories(${BOARDDIR})

set(CONNDIR ${ROOTDIR}/src/network/coap/zoap)
file(GLOB CONNSRC ${CONNDIR}/*.c)
target_sources(app PRIVATE ${CONNSRC})
include_directories(${CONNDIR})

add_definitions(-DSIMPLE_MANIFEST=1 -DLOGGER_VERBOSITY=3)
add_definitions(-DWITH_CONNECTION_ZOAP=1)
add_definitions(-DMEMORY_FLASH_IMPL=1 -DWITH_PLATFORM_NRF52840=1)

# Add the board files
include_directories(${ROOTDIR}/test/platform)
```

## prj.conf
```kconfig
CONFIG_CPLUSPLUS=y

CONFIG_DEBUG=y
CONFIG_STDOUT_CONSOLE=y

CONFIG_SYS_CLOCK_TICKS_PER_SEC=1000

CONFIG_BT=n

CONFIG_MAIN_STACK_SIZE=2048

CONFIG_NETWORKING=y
CONFIG_ENTROPY_GENERATOR=y
CONFIG_ENTROPY_NRF5_RNG=y

CONFIG_NET_PKT_RX_COUNT=50
CONFIG_NET_PKT_TX_COUNT=50
CONFIG_NET_BUF_RX_COUNT=50
CONFIG_NET_BUF_TX_COUNT=50

CONFIG_NET_TX_STACK_SIZE=2048
CONFIG_NET_RX_STACK_SIZE=3072

CONFIG_NET_IPV4=n
CONFIG_NET_IPV6=y
CONFIG_NET_IF_UNICAST_IPV6_ADDR_COUNT=10
CONFIG_NET_IPV6_NBR_CACHE=n
CONFIG_NET_IPV6_MLD=n

CONFIG_REBOOT=y

CONFIG_NET_LOG=y
CONFIG_SYS_LOG_SHOW_COLOR=y
CONFIG_PRINTK=y

CONFIG_UART_INTERRUPT_DRIVEN=y

CONFIG_FLASH=y
CONFIG_FLASH_PAGE_LAYOUT=y
CONFIG_MPU_ALLOW_FLASH_WRITE=y

CONFIG_NET_L2_OPENTHREAD=y
CONFIG_OPENTHREAD_L2_DEBUG=y
CONFIG_OPENTHREAD_L2_LOG_LEVEL_INFO=y
CONFIG_OPENTHREAD_CHANNEL=13
CONFIG_IEEE802154_NRF5=y

CONFIG_NET_APP=y
CONFIG_NET_APP_NEED_IPV6=y
CONFIG_NET_APP_CLIENT=y
CONFIG_NET_APP_SETTINGS=y
CONFIG_NET_APP_MY_IPV6_ADDR="fd11:22::2"

CONFIG_NET_UDP=y
CONFIG_TEST_RANDOM_GENERATOR=y
CONFIG_COAP=y

CONFIG_SYS_LOG_NET_LEVEL=4
```

## prj_nrf52840_ot.conf
```kconfig
CONFIG_CPLUSPLUS=y

CONFIG_SYS_CLOCK_TICKS_PER_SEC=1000

CONFIG_BT=n

CONFIG_COAP=y

CONFIG_NETWORKING=y
CONFIG_ENTROPY_GENERATOR=y
CONFIG_ENTROPY_NRF5_RNG=y

CONFIG_NET_PKT_RX_COUNT=50
CONFIG_NET_PKT_TX_COUNT=50
CONFIG_NET_BUF_RX_COUNT=50
CONFIG_NET_BUF_TX_COUNT=50

CONFIG_NET_TX_STACK_SIZE=2048
CONFIG_NET_RX_STACK_SIZE=3072

CONFIG_NET_IPV4=n
CONFIG_NET_IPV6=y
CONFIG_NET_IF_UNICAST_IPV6_ADDR_COUNT=10
CONFIG_NET_IPV6_NBR_CACHE=n
CONFIG_NET_IPV6_MLD=n

CONFIG_REBOOT=y

CONFIG_NET_LOG=y
CONFIG_PRINTK=y

CONFIG_UART_INTERRUPT_DRIVEN=y

CONFIG_FLASH=y
CONFIG_FLASH_PAGE_LAYOUT=y
CONFIG_MPU_ALLOW_FLASH_WRITE=y

CONFIG_NET_L2_OPENTHREAD=y
CONFIG_OPENTHREAD_CHANNEL=15
CONFIG_IEEE802154_NRF5=y

CONFIG_NET_APP=y
CONFIG_NET_APP_CLIENT=y
```

## src/main.c
```c
#include <stdlib.h>
#include <stdio.h>

#define SERVER_ADDR "fd11:22::38d3:2ff5:4d7:bc9d"

#include "network.h" // Test header

int main() {
    nTEST_INIT();
    printk("hey\n");
    nTEST_RUN(test_conn);
    nTEST_END();
    return 0;
}
```

## CMakeLists.txt
```
cmake_minimum_required(VERSION 3.11)
include($ENV{ZEPHYR_BASE}/cmake/app/boilerplate.cmake NO_POLICY_SCOPE)
project(application_ble)

target_sources(app PRIVATE src/main.c)

set(ROOTDIR "../../..")

# Add libpull to the build
file(GLOB_RECURSE libpull_src ${ROOTDIR}/src/*.c)
file(GLOB libpull_headers ${ROOTDIR}/include)
target_sources(app PRIVATE ${libpull_src})
include_directories(${libpull_headers} ${ROOTDIR})

add_definitions(-DSIMPLE_MANIFEST=1 -DLOGGER_VERBOSITY=0)
add_definitions(-DMEMORY_FLASH_IMPL=1)
add_definitions(-DDISABLE_LIBPULL_NETWORK=1)
add_definitions(-DWITH_ZEPHYR_BLE=1)
add_definitions(-DWITH_PLATFORM_NRF52840=1)

set(TINYCRYPT 1) # TINYCRYPT or TINYDTLS or MBEDTLS
if (TINYCRYPT)
    add_definitions(-DWITH_TINYCRYPT=1)
elseif(TINYDTLS)
    add_definitions(-DWITH_TINYDTLS=1)
    include_directories(${ROOTDIR}/ext/tinydtls)
    file(GLOB ecc_src ${ROOTDIR}/ext/tinydtls/ecc/ecc.c)
    file(GLOB sha2_src ${ROOTDIR}/ext/tinydtls/sha2/sha2.c)
    add_definitions(-DWITH_SHA256 -DSHA2_USE_INTTYPES_H)
    target_sources(app PRIVATE ${ecc_src} ${sha2_src})
elseif(MBEDTLS)
    add_definitions(-DWITH_MBEDTLS=1)
endif(TINYCRYPT)

include_directories(${ROOTDIR}/src/platform/nrf52840)
```

## prj.conf
```kconfig
CONFIG_DEBUG=y
CONFIG_STDOUT_CONSOLE=y

CONFIG_REBOOT=y
CONFIG_HAS_FLASH_LOAD_OFFSET=y
CONFIG_TEXT_SECTION_OFFSET=0x9100

CONFIG_BT=y
CONFIG_BT_PERIPHERAL=y
CONFIG_BT_DEVICE_NAME="Libpull"

CONFIG_FLASH=y
CONFIG_FLASH_PAGE_LAYOUT=y
CONFIG_MPU_ALLOW_FLASH_WRITE=y

CONFIG_TINYCRYPT=y
CONFIG_TINYCRYPT_SHA256=y
CONFIG_TINYCRYPT_ECC_DSA=y
```

## prj_nrf52840_pca10056.conf
```kconfig
CONFIG_DEBUG=n
CONFIG_STDOUT_CONSOLE=n
CONFIG_SIZE_OPTIMIZATIONS=y

CONFIG_REBOOT=y
CONFIG_HAS_FLASH_LOAD_OFFSET=y
CONFIG_TEXT_SECTION_OFFSET=0x9100

CONFIG_BT=y
CONFIG_BT_PERIPHERAL=y
CONFIG_BT_DEVICE_NAME="Libpull"

CONFIG_FLASH=y
CONFIG_FLASH_PAGE_LAYOUT=y
CONFIG_MPU_ALLOW_FLASH_WRITE=y

CONFIG_TINYCRYPT=y
CONFIG_TINYCRYPT_SHA256=y
CONFIG_TINYCRYPT_ECC_DSA=y

# Increase ATT_MTU
CONFIG_BT_RX_STACK_SIZE=2048
CONFIG_BT_L2CAP_RX_MTU=256
CONFIG_BT_L2CAP_TX_MTU=256

CONFIG_PRINTK=n
CONFIG_EARLY_CONSOLE=n
CONFIG_BOOT_BANNER=n
CONFIG_ERRNO=n
CONFIG_SYS_POWER_MANAGEMENT=n
```

## src/main.c
```c
#include <zephyr.h>
#include <string.h>
#include <stdio.h>

#include <bluetooth/bluetooth.h>
#include <bluetooth/conn.h>
#include <bluetooth/gatt.h>

#include <libpull/network/gatt.h>
#include "platform_headers.h"
#include "default_keys.h"

#define DEVICE_NAME	CONFIG_BT_DEVICE_NAME
#define DEVICE_NAME_LEN	(sizeof(DEVICE_NAME) - 1)

#if  WITH_TINYCRYPT
int default_CSPRNG(uint8_t *dest, unsigned int size) {
    return 0;
}
#endif

static const struct bt_data ad[] = {
	BT_DATA_BYTES(BT_DATA_FLAGS, BT_LE_AD_NO_BREDR),
	BT_DATA_BYTES(BT_DATA_UUID16_ALL, 0x0a, 0x18),
};

static const struct bt_data sd[] = {
	BT_DATA(BT_DATA_NAME_COMPLETE, DEVICE_NAME, DEVICE_NAME_LEN),
};

int main(void) {
	if (bt_enable(NULL)) {
		log_debug("Bluetooth init failed (err %d)\n", err);
		return 1;
	}

    mem_object_t obj;
    libpull_gatt_init(&safestore_g, &obj);

	if (bt_le_adv_start(BT_LE_ADV_CONN, ad, ARRAY_SIZE(ad), sd, ARRAY_SIZE(sd))) {
		log_debug("Advertising failed (err %d)\n", err);
		return 1;
	}
    log_debug("Advertising...");
    return 0;
}
```

## src/libpull_fsm.c
```c
#include "libpull_fsm.h"

#include <libpull/memory.h>

// XXX This must be removed
#include "platform_headers.h"
#include "default_keys.h"
#include <libpull/security.h>

int default_CSPRNG(uint8_t *dest, unsigned int size) {
    return 0;
}

pull_error libpull_fsm_init(libpull_fsm_ctx_t* ctx, mem_object_t* obj) {
    ctx->state = STATE_IDLE;
    ctx->result = RESULT_INIT;
    ctx->obj = obj;

    ctx->platform = 0xbeef; /* TODO This should be taken from some general structure */

    // (0) Get the newest version available
    mem_id_t ignore;
    pull_error err = get_newest_firmware(&ignore, &ctx->version, ctx->obj, false, false);
    if (err) {
        log_error(err, "Error getting newest firmware\n");
        return err;
    }
    log_debug("Version is %u\n", ctx->version);
    return PULL_SUCCESS;
}

pull_error fsm_pre_verification(manifest_t* mt, void* user_data) {
    /*log_info("Validating received manifest\n");
    libpull_fsm_ctx_t* ctx = (libpull_fsm_ctx_t*) user_data;
    if (get_version(mt) <= ctx->version) {
        log_debug("received version: %u - local version: %u\n", get_version(mt), ctx->version);
        log_error(INVALID_OBJECT_ERROR, "Received firmware has invalid version\n");
        return INVALID_OBJECT_ERROR;
    }
    if (get_platform(mt) != ctx->platform) {
        log_debug("received platform: %u - local platform: %u\n", get_platform(mt), ctx->platform);
        log_error(INVALID_OBJECT_ERROR, "Received firmware has invalid platform\n");
        return INVALID_OBJECT_ERROR;
    }*/
    return PULL_SUCCESS;
}

#define BUFFER_SIZE 1024
uint8_t buffer[BUFFER_SIZE];

pull_error fsm_post_verification(mem_object_t* obj, void* user_data) {
    // XXX These informations should be derived from the specific user data
    return verify_object(obj, tinycrypt_digest_sha256, vendor_x_g, vendor_y_g,
            tinycrypt_secp256r1_ecc, buffer, BUFFER_SIZE);
}

pull_error libpull_fsm_receive(libpull_fsm_ctx_t* ctx, libpull_cmd_t cmd, const uint8_t* buf, size_t len) {
    pull_error err;
    version_t ignore;
    switch (ctx->state) {
        case STATE_IDLE:
            if (cmd != CMD_PACKAGE) {
                break;
            }
            // (0) Get oldest memory object
            err = get_oldest_firmware(&ctx->id, &ignore, ctx->obj, true, true);
            if (err) {
                log_error(err, "Error getting the oldest slot");
                return err;
            }
            // (1) Open the memory object
            err = memory_open(ctx->obj, ctx->id, WRITE_ALL);
            if (err) {
                log_error(err, "Error opening the memory_object\n");
                return err;
            }
            // (2) Open the writer
            err = writer_open(&ctx->wctx, ctx->obj, fsm_pre_verification, ctx);
            if (err) {
                log_error(err, "Error opening the memory_object\n");
                return err;
            }
            ctx->state = STATE_DOWNLOADING;
            if (len == 0 || buf == NULL) {
                break;
            }
            /* fallthrough */
        case STATE_DOWNLOADING:
            if (cmd != CMD_PACKAGE || len == 0 || buf == NULL) {
                return GENERIC_ERROR;
            }
            if ((err = writer_chunk(&ctx->wctx, buf, len)) != PULL_SUCCESS) {
                log_error(err, "Error writing chunk\n");
                ctx->state = STATE_IDLE;
                ctx->result = RESULT_CONNECTION_LOST;
                /* TODO: specialize errors */
                return err;
            }
            ctx->received += len;
            if (!ctx->wctx.manifest_received || /* TODO This can become something like: ctx->wctx.received() */
                (ctx->wctx.manifest_received && (ctx->wctx.received < ctx->wctx.expected))) {
                break;
            }
            log_debug("Changing state to downloaded\n");
            memory_close(ctx->obj);
            ctx->state = STATE_DOWNLOADED;
            break;
        case STATE_DOWNLOADED:
            if (cmd != CMD_UPDATE) {
                break;
            }
            /* received an update command */
            ctx->state = STATE_UPDATING;
            /* fallthrough */
        case STATE_UPDATING:
            // (2) perform verification
            log_debug("Performing verification\n");
            memory_open(ctx->obj, ctx->id, READ_ONLY);
            err = fsm_post_verification(ctx->obj, NULL /* here I must pass some data */);
            memory_close(ctx->obj);
            if (err) {
                log_error(err, "Verification failed\n");
                invalidate_object(ctx->id, ctx->obj);
                ctx->result = RESULT_INTEGRITY_CHECK;
                ctx->state = STATE_IDLE;
                return err;
            }
            log_debug("Verification failed\n");
            ctx->result = RESULT_SUCCESS;
            break;
        default:
            /* TODO manage this error */
            return GENERIC_ERROR;
    }
    return PULL_SUCCESS;
}
```

## src/libpull_fsm.h
```c
#ifndef LIBPULL_libpull_fsm_H_
#define LIBPULL_libpull_fsm_H_

#include <libpull/common.h>
#include <libpull/network/writer.h>

#define UPDATE_CMD_VAL     0xab
#define UPDATE_CMD_LEN 1

typedef enum libpull_cmd_t {
    CMD_PACKAGE,
    CMD_UPDATE,
} libpull_cmd_t;

enum libpull_state_t {
    STATE_IDLE = 0,
    STATE_DOWNLOADING = 1,
    STATE_DOWNLOADED = 2,
    STATE_UPDATING = 3
};

enum libpull_result_t {
    RESULT_INIT = 0,
    RESULT_SUCCESS = 1,
    RESULT_IMAGE_TOO_BIG = 2,
    RESULT_OUT_OF_RAM = 3,
    RESULT_CONNECTION_LOST = 4,
    RESULT_INTEGRITY_CHECK = 5,
    RESULT_UNSUPPORTED_PACKAGE = 6,
    RESULT_INVALID_URI = 7,
    RESULT_UPDATE_FAILED = 8,
    RESULT_UNSUPPORTED_PROTOCOL = 9
};

typedef uint8_t libpull_state_t;
typedef uint8_t libpull_result_t;

typedef struct libpull_fsm_ctx_t {
    version_t version;
    platform_t platform;
    identity_t identity;
    libpull_state_t state;
    libpull_result_t result;
    uint32_t received;
    writer_ctx_t wctx;
    mem_id_t id;
    mem_object_t* obj;
} libpull_fsm_ctx_t;

pull_error libpull_fsm_init(libpull_fsm_ctx_t* ctx, mem_object_t* obj);

pull_error fsm_pre_verification(manifest_t* mt, void* user_data);

pull_error fsm_post_verification(mem_object_t* obj, void* user_data);

pull_error libpull_fsm_receive(libpull_fsm_ctx_t* ctx, libpull_cmd_t cmd, const uint8_t* buf, size_t len);

#endif /* LIBPULL_libpull_fsm_H_ */
```

## src/libpull_gatt.c
```c
#include <string.h>
#include <zephyr.h>

#include <bluetooth/bluetooth.h>
#include <bluetooth/gatt.h>
#include <bluetooth/uuid.h>

#include <libpull/common.h>
#include <libpull/network/writer.h>

#include "platform_headers.h"

#include "libpull_gatt.h"

libpull_fsm_ctx_t ctx;

/* Libpull GATT service UUIDs */
static struct bt_uuid_128 libpull_service_udid =
BT_UUID_INIT_128(LIBPULL_SERVICE_UUID);

static const struct bt_uuid_128 libpull_version =
BT_UUID_INIT_128(LIBPULL_VERSION_UUID);

static const struct bt_uuid_128 libpull_platform =
BT_UUID_INIT_128(LIBPULL_PLATFORM_UUID);

static const struct bt_uuid_128 libpull_identity =
BT_UUID_INIT_128(LIBPULL_IDENTITY_UUID);

static const struct bt_uuid_128 libpull_update =
BT_UUID_INIT_128(LIBPULL_UPDATE_UUID);

static const struct bt_uuid_128 libpull_state =
BT_UUID_INIT_128(LIBPULL_STATE_UUID);

static const struct bt_uuid_128 libpull_result =
BT_UUID_INIT_128(LIBPULL_RESULT_UUID);

static const struct bt_uuid_128 libpull_received =
BT_UUID_INIT_128(LIBPULL_RECEIVED_UUID);

static const struct bt_uuid_128 libpull_image =
BT_UUID_INIT_128(LIBPULL_IMAGE_UUID);

static ssize_t gatt_read_uint8(struct bt_conn *conn,
        const struct bt_gatt_attr *attr, void *buf,
        uint16_t len, uint16_t offset) {
    void *value = attr->user_data;
    return bt_gatt_attr_read(conn, attr, buf, len, offset, value,
            sizeof(uint8_t));
}
static ssize_t gatt_read_uint16(struct bt_conn *conn,
        const struct bt_gatt_attr *attr, void *buf,
        uint16_t len, uint16_t offset) {
    void *value = attr->user_data;
    return bt_gatt_attr_read(conn, attr, buf, len, offset, value,
            sizeof(uint16_t));
}
static ssize_t gatt_read_uint32(struct bt_conn *conn,
        const struct bt_gatt_attr *attr, void *buf,
        uint16_t len, uint16_t offset) {
    void *value = attr->user_data;
    return bt_gatt_attr_read(conn, attr, buf, len, offset, value,
            sizeof(uint32_t));
}

static ssize_t gatt_read_identity(struct bt_conn *conn,
        const struct bt_gatt_attr *attr, void *buf,
        uint16_t len, uint16_t offset) {
    void *value = attr->user_data;
    return bt_gatt_attr_read(conn, attr, buf, len, offset, value,
            sizeof(identity_t));
}

static ssize_t libpull_fsm(struct bt_conn *conn,
        const struct bt_gatt_attr *attr,
        const void *buf, uint16_t len,
        uint16_t offset, uint8_t flags);

static uint8_t update_characteristic = 0x0;
static uint8_t image_characteristic = 0x1;

static struct bt_gatt_ccc_cfg notify_state[BT_GATT_CCC_MAX] = {};
static struct bt_gatt_ccc_cfg notify_result[BT_GATT_CCC_MAX] = {};

uint8_t notify_state_flag = 0;
uint8_t notify_result_flag = 0;

static void notify_state_cb(const struct bt_gatt_attr *attr, u16_t value) {
    printf("received request for notify state\n");
    notify_state_flag = (value == BT_GATT_CCC_NOTIFY)? 1 : 0;
}
static void notify_result_cb(const struct bt_gatt_attr *attr, u16_t value) {
    printf("received request for notify result\n");
    notify_result_flag = (value == BT_GATT_CCC_NOTIFY)? 1 : 0;
}

static struct bt_gatt_attr libpull_attrs[] = {
    /* 0 Vendor Primary Service Declaration */
    BT_GATT_PRIMARY_SERVICE(&libpull_service_udid),
    /* 1 READ ONLY version */
    BT_GATT_CHARACTERISTIC(&libpull_version.uuid,
            BT_GATT_CHRC_READ,
            BT_GATT_PERM_READ,
            gatt_read_uint16, NULL, &ctx.version),
    /* 2 READ ONLY platform */
    BT_GATT_CHARACTERISTIC(&libpull_platform.uuid,
            BT_GATT_CHRC_READ,
            BT_GATT_PERM_READ,
            gatt_read_uint16, NULL, &ctx.platform),
    /* 3 READ ONLY identity */
    BT_GATT_CHARACTERISTIC(&libpull_identity.uuid,
            BT_GATT_CHRC_READ,
            BT_GATT_PERM_READ,
            gatt_read_identity, NULL, &ctx.identity),
    /* 4 WRITE ONLY update */
    BT_GATT_CHARACTERISTIC(&libpull_update.uuid,
            BT_GATT_CHRC_WRITE,
            BT_GATT_PERM_WRITE,
            NULL, libpull_fsm, &update_characteristic),
    /* READ ONLY state */
    BT_GATT_CHARACTERISTIC(&libpull_state.uuid,
            BT_GATT_CHRC_READ | BT_GATT_CHRC_NOTIFY,
            BT_GATT_PERM_READ,
            gatt_read_uint8, NULL, &ctx.state),
    BT_GATT_CCC(notify_state, notify_state_cb),
    /* 7 READ ONLY result */
    BT_GATT_CHARACTERISTIC(&libpull_result.uuid,
            BT_GATT_CHRC_READ | BT_GATT_CHRC_NOTIFY,
            BT_GATT_PERM_READ,
            gatt_read_uint8, NULL, &ctx.result),
    BT_GATT_CCC(notify_result, notify_result_cb), /* 8 */
    /* 9 READ ONLY written bytes */
    BT_GATT_CHARACTERISTIC(&libpull_received.uuid,
            BT_GATT_CHRC_READ,
            BT_GATT_PERM_READ,
            gatt_read_uint32, NULL, &ctx.received),
    /* 10 WRITE ONLY firmware */
    BT_GATT_CHARACTERISTIC(&libpull_image.uuid,
            BT_GATT_CHRC_WRITE | BT_GATT_CHRC_WRITE_WITHOUT_RESP,
            BT_GATT_PERM_WRITE,
            NULL, libpull_fsm, &image_characteristic),
};

static const uint8_t update_cmd = UPDATE_CMD_VAL;

static ssize_t libpull_fsm(struct bt_conn *conn,
        const struct bt_gatt_attr *attr,
        const void *buf, uint16_t len,
        uint16_t offset, uint8_t flags) {
    uint8_t* characteristic = attr->user_data;
    uint8_t old_state = ctx.state;
    uint8_t old_result = ctx.result;
    pull_error err;
    log_debug("\nReceived %u bytes\n", len);
    libpull_cmd_t cmd = (*characteristic == update_characteristic)? CMD_UPDATE: CMD_PACKAGE;
    err = libpull_fsm_receive(&ctx, cmd, buf, len);
    if (err) {
        log_error(err, "Error in the fsm\n");
        return 0;
    }
    if (notify_state_flag && (old_state != ctx.state)) {
        bt_gatt_notify(NULL, &libpull_attrs[10], &ctx.state, sizeof(uint8_t));
    }
    if (notify_result_flag && (old_result != ctx.result)) {
        bt_gatt_notify(NULL, &libpull_attrs[13], &ctx.result, sizeof(uint8_t));
    }
    return len;
}

static struct bt_gatt_service libpull_service = BT_GATT_SERVICE(libpull_attrs);

pull_error libpull_gatt_init(mem_object_t *obj) {
    pull_error err = libpull_fsm_init(&ctx, obj);
    if (err) {
        log_error(err, "Error initializing push receiver\n");
        return err;
    }
    if (bt_gatt_service_register(&libpull_service) != 0) {
        log_error(err, "Error registering gatt service\n");
        return RECEIVER_OPEN_ERROR;
    }
    return PULL_SUCCESS;
}
```

## src/libpull_gatt.h
```c
#ifndef LIBPULL_NETWORK_GATT_H_
#define LIBPULL_NETWORK_GATT_H_

#ifdef __cplusplus
extern "C" {
#endif

#include "libpull_fsm.h"

/* These UUID has been generated using
 * https://www.uuidgenerator.net */

#define LIBPULL_SERVICE_UUID \
    0xf0, 0x08, 0xb7, 0x9c, 0x00, 0x0f, 0x86, 0x93, \
    0xf2, 0x46, 0x51, 0x14, 0x7d, 0x5b, 0x49, 0x58

#define LIBPULL_VERSION_UUID \
    0xf1, 0x08, 0xb7, 0x9c, 0x00, 0x0f, 0x86, 0x93, \
    0xf2, 0x46, 0x51, 0x14, 0x7d, 0x5b, 0x49, 0x58

#define LIBPULL_PLATFORM_UUID \
    0xf2, 0x08, 0xb7, 0x9c, 0x00, 0x0f, 0x86, 0x93, \
    0xf2, 0x46, 0x51, 0x14, 0x7d, 0x5b, 0x49, 0x58

#define LIBPULL_IDENTITY_UUID \
    0xf3, 0x08, 0xb7, 0x9c, 0x00, 0x0f, 0x86, 0x93, \
    0xf2, 0x46, 0x51, 0x14, 0x7d, 0x5b, 0x49, 0x58

#define LIBPULL_UPDATE_UUID \
    0xf4, 0x08, 0xb7, 0x9c, 0x00, 0x0f, 0x86, 0x93, \
    0xf2, 0x46, 0x51, 0x14, 0x7d, 0x5b, 0x49, 0x58
#define LIBPULL_STATE_UUID \
    0xf5, 0x08, 0xb7, 0x9c, 0x00, 0x0f, 0x86, 0x93, \
    0xf2, 0x46, 0x51, 0x14, 0x7d, 0x5b, 0x49, 0x58

#define LIBPULL_RESULT_UUID \
    0xf6, 0x08, 0xb7, 0x9c, 0x00, 0x0f, 0x86, 0x93, \
    0xf2, 0x46, 0x51, 0x14, 0x7d, 0x5b, 0x49, 0x58

/*#define LIBPULL_STATE_UUID \
    0xfb, 0x34, 0x9b, 0x5f, 0x80, 0x00, 0x00, 0x80, \
    0x00, 0x10, 0x00, 0x00, 0x32, 0x45, 0x00, 0x00

#define LIBPULL_RESULT_UUID \
    0xfb, 0x34, 0x9b, 0x5f, 0x80, 0x00, 0x00, 0x80, \
    0x00, 0x10, 0x00, 0x00, 0x33, 0x45, 0x00, 0x00
*/

#define LIBPULL_RECEIVED_UUID \
    0xf7, 0x08, 0xb7, 0x9c, 0x00, 0x0f, 0x86, 0x93, \
    0xf2, 0x46, 0x51, 0x14, 0x7d, 0x5b, 0x49, 0x58

#define LIBPULL_IMAGE_UUID \
    0xf8, 0x08, 0xb7, 0x9c, 0x00, 0x0f, 0x86, 0x93, \
    0xf2, 0x46, 0x51, 0x14, 0x7d, 0x5b, 0x49, 0x58

pull_error libpull_gatt_init();

#ifdef __cplusplus
}
#endif

#endif /* LIBPULL_NETWORK_GATT_H_ */
```

## src/push_receiver.c
```c
#include "push_receiver.h"

#include <libpull/memory.h>

// XXX This must be removed
#include "platform_headers.h"
#include "default_keys.h"
#include <libpull/security.h>

int default_CSPRNG(uint8_t *dest, unsigned int size) {
    return 0;
}

pull_error push_receiver_init(push_receiver_ctx_t* ctx, mem_object_t* obj) {
    ctx->state = STATE_IDLE;
    ctx->result = RESULT_INIT;
    ctx->obj = obj;

    ctx->platform = 0xbeef; /* TODO This should be taken from some general structure */

    // (0) Get the newest version available
    mem_id_t ignore;
    pull_error err = get_newest_firmware(&ignore, &ctx->version, ctx->obj, false, false);
    if (err) {
        log_error(err, "Error getting newest firmware\n");
        return err;
    }
    log_debug("Version is %u\n", ctx->version);
    return PULL_SUCCESS;
}

pull_error pre_verification(manifest_t* mt, void* user_data) {
    /*log_info("Validating received manifest\n");
    push_receiver_ctx_t* ctx = (push_receiver_ctx_t*) user_data;
    if (get_version(mt) <= ctx->version) {
        log_debug("received version: %u - local version: %u\n", get_version(mt), ctx->version);
        log_error(INVALID_OBJECT_ERROR, "Received firmware has invalid version\n");
        return INVALID_OBJECT_ERROR;
    }
    if (get_platform(mt) != ctx->platform) {
        log_debug("received platform: %u - local platform: %u\n", get_platform(mt), ctx->platform);
        log_error(INVALID_OBJECT_ERROR, "Received firmware has invalid platform\n");
        return INVALID_OBJECT_ERROR;
    }*/
    return PULL_SUCCESS;
}

#define BUFFER_SIZE 1024
uint8_t buffer[BUFFER_SIZE];

pull_error post_verification(mem_object_t* obj, void* user_data) {
    // XXX These informations should be derived from the specific user data
    return verify_object(obj, tinycrypt_digest_sha256, vendor_x_g, vendor_y_g,
            tinycrypt_secp256r1_ecc, buffer, BUFFER_SIZE);
}

pull_error push_receiver_receive(push_receiver_ctx_t* ctx, libpull_cmd_t cmd, const uint8_t* buf, size_t len) {
    pull_error err;
    version_t ignore;
    switch (ctx->state) {
        case STATE_IDLE:
            if (cmd != CMD_PACKAGE) {
                break;
            }
            // (0) Get oldest memory object
            err = get_oldest_firmware(&ctx->id, &ignore, ctx->obj, true, true);
            if (err) {
                log_error(err, "Error getting the oldest slot");
                return err;
            }
            // (1) Open the memory object
            err = memory_open(ctx->obj, ctx->id, WRITE_ALL);
            if (err) {
                log_error(err, "Error opening the memory_object\n");
                return err;
            }
            // (2) Open the writer
            err = writer_open(&ctx->wctx, ctx->obj, pre_verification, ctx);
            if (err) {
                log_error(err, "Error opening the memory_object\n");
                return err;
            }
            ctx->state = STATE_DOWNLOADING;
            if (len == 0 || buf == NULL) {
                break;
            }
            /* fallthrough */
        case STATE_DOWNLOADING:
            if (cmd != CMD_PACKAGE || len == 0 || buf == NULL) {
                return GENERIC_ERROR;
            }
            if ((err = writer_chunk(&ctx->wctx, buf, len)) != PULL_SUCCESS) {
                log_error(err, "Error writing chunk\n");
                ctx->state = STATE_IDLE;
                ctx->result = RESULT_CONNECTION_LOST;
                /* TODO: specialize errors */
                return err;
            }
            ctx->received += len;
            if (!ctx->wctx.manifest_received || /* TODO This can become something like: ctx->wctx.received() */
                (ctx->wctx.manifest_received && (ctx->wctx.received < ctx->wctx.expected))) {
                break;
            }
            log_debug("Changing state to downloaded\n");
            memory_close(ctx->obj);
            ctx->state = STATE_DOWNLOADED;
            break;
        case STATE_DOWNLOADED:
            if (cmd != CMD_UPDATE) {
                break;
            }
            /* received an update command */
            ctx->state = STATE_UPDATING;
            /* fallthrough */
        case STATE_UPDATING:
            // (2) perform verification
            log_debug("Performing verification\n");
            memory_open(ctx->obj, ctx->id, READ_ONLY);
            err = post_verification(ctx->obj, NULL /* here I must pass some data */);
            memory_close(ctx->obj);
            if (err) {
                log_error(err, "Verification failed\n");
                invalidate_object(ctx->id, ctx->obj);
                ctx->result = RESULT_INTEGRITY_CHECK;
                ctx->state = STATE_IDLE;
                return err;
            }
            ctx->result = RESULT_SUCCESS;
            break;
        default:
            /* TODO manage this error */
            return GENERIC_ERROR;
    }
    return PULL_SUCCESS;
}
```

## src/push_receiver.h
```c
#ifndef LIBPULL_PUSH_RECEIVER_H_
#define LIBPULL_PUSH_RECEIVER_H_

#include <libpull/common.h>
#include <libpull/network/writer.h>

#define UPDATE_CMD_VAL     0xab
#define UPDATE_CMD_LEN 1

typedef enum libpull_cmd_t {
    CMD_PACKAGE,
    CMD_UPDATE,
} libpull_cmd_t;

enum libpull_state_t {
    STATE_IDLE = 0,
    STATE_DOWNLOADING = 1,
    STATE_DOWNLOADED = 2,
    STATE_UPDATING = 3
};

enum libpull_result_t {
    RESULT_INIT = 0,
    RESULT_SUCCESS = 1,
    RESULT_IMAGE_TOO_BIG = 2,
    RESULT_OUT_OF_RAM = 3,
    RESULT_CONNECTION_LOST = 4,
    RESULT_INTEGRITY_CHECK = 5,
    RESULT_UNSUPPORTED_PACKAGE = 6,
    RESULT_INVALID_URI = 7,
    RESULT_UPDATE_FAILED = 8,
    RESULT_UNSUPPORTED_PROTOCOL = 9
};

typedef uint8_t libpull_state_t;
typedef uint8_t libpull_result_t;

typedef struct push_receiver_ctx_t {
    version_t version;
    platform_t platform;
    identity_t identity;
    libpull_state_t state;
    libpull_result_t result;
    uint32_t received;
    writer_ctx_t wctx;
    mem_id_t id;
    mem_object_t* obj;
} push_receiver_ctx_t;

pull_error push_receiver_init(push_receiver_ctx_t* ctx, mem_object_t* obj);

pull_error pre_verification(manifest_t* mt, void* user_data);

pull_error post_verification(mem_object_t* obj, void* user_data);

pull_error push_receiver_receive(push_receiver_ctx_t* ctx, libpull_cmd_t cmd, const uint8_t* buf, size_t len);

#endif /* LIBPULL_PUSH_RECEIVER_H_ */
```

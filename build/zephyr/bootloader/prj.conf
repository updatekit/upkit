## CMakeLists.txt
```
cmake_minimum_required(VERSION 3.11)
include($ENV{ZEPHYR_BASE}/cmake/app/boilerplate.cmake NO_POLICY_SCOPE)
project(bootloader)

target_sources(app PRIVATE src/bootloader.c)

set(ROOTDIR "../../..")

# Add libpull to the build
file(GLOB_RECURSE libpull_src ${ROOTDIR}/src/*.c)
file(GLOB libpull_headers ${ROOTDIR}/include)
target_sources(app PRIVATE ${libpull_src})
include_directories(${libpull_headers} ${ROOTDIR})

add_definitions(-DSIMPLE_MANIFEST=1 -DLOGGER_VERBOSITY=4)
add_definitions(-DMEMORY_FLASH_IMPL=1 -DDISABLE_LIBPULL_NETWORK=1)
add_definitions(-DWITH_BOOTLOADER=1 -DEVAL=1)
add_definitions(-DWITH_PLATFORM_NRF52840=1 -DWITH_ARM_CORTEX_LOADER=1)

set(TINYCRYPT 1) # TINYCRYPT or TINYDTLS or MBEDTLS
if (TINYCRYPT)
    add_definitions(-DWITH_TINYCRYPT=1)
elseif(TINYDTLS)
    add_definitions(-DWITH_TINYDTLS=1)
    include_directories(${ROOTDIR}/ext/tinydtls)
    file(GLOB ecc_src ${ROOTDIR}/ext/tinydtls/ecc/ecc.c)
    file(GLOB sha2_src ${ROOTDIR}/ext/tinydtls/sha2/sha2.c)
    add_definitions(-DWITH_SHA256 -DSHA2_USE_INTTYPES_H)
    target_sources(app PRIVATE ${ecc_src} ${sha2_src})
elseif(MBEDTLS)
    add_definitions(-DWITH_MBEDTLS=1)
endif(TINYCRYPT)

# Add the board headers
include_directories(${ROOTDIR}/src/platform/nrf52840)
```

## prj.conf
```kconfig
CONFIG_DEBUG=y

CONFIG_BT=n

CONFIG_STDOUT_CONSOLE=y

CONFIG_MAIN_STACK_SIZE=2048

CONFIG_SYSTEM_CLOCK_DISABLE=y

CONFIG_TINYCRYPT=y
CONFIG_TINYCRYPT_SHA256=y
CONFIG_TINYCRYPT_ECC_DSA=y

CONFIG_FLASH=y
CONFIG_FLASH_PAGE_LAYOUT=y
CONFIG_MPU_ALLOW_FLASH_WRITE=y
```

## prj_nrf52840_pca10056.conf
```kconfig
CONFIG_MULTITHREADING=n
CONFIG_SIZE_OPTIMIZATIONS=y
CONFIG_DEBUG=n

CONFIG_BT=n

CONFIG_STDOUT_CONSOLE=n

CONFIG_MAIN_STACK_SIZE=2048

CONFIG_SYSTEM_CLOCK_DISABLE=y

CONFIG_TINYCRYPT=y
CONFIG_TINYCRYPT_SHA256=y
CONFIG_TINYCRYPT_ECC_DSA=y

CONFIG_FLASH=y
CONFIG_FLASH_PAGE_LAYOUT=y
CONFIG_MPU_ALLOW_FLASH_WRITE=y

CONFIG_PRINTK=n
CONFIG_EARLY_CONSOLE=n
CONFIG_BOOT_BANNER=n
CONFIG_ERRNO=n
CONFIG_SYS_POWER_MANAGEMENT=n

#CONFIG_CONSOLE=n
#CONFIG_SYS_LOG=n
```

## src/bootloader.c
```c
#include <libpull_agents/bootloader_agent.h>
#include "default_keys.h"

#define WITH_BOOTLOADER 1
#include "platform_headers.h"

#include <stdio.h>
#include <stdlib.h>
#include <string.h>
#include <stdint.h>

#define BUFFER_SIZE 2048
#define SWAP_SIZE 2048

static uint8_t buffer[BUFFER_SIZE];

#if  WITH_TINYCRYPT
int default_CSPRNG(uint8_t *dest, unsigned int size) {
    return 0;
}
#endif

int main(void) {
    bootloader_agent_config cfg;
    cfg.bootloader_ctx_id = BOOTLOADER_CTX;
    cfg.swap_id = SWAP;
    cfg.swap_size = SWAP_SIZE;
    cfg.safestore = &safestore_g;
    bootloader_agent_set_buffer(&cfg, buffer, BUFFER_SIZE);

    log_debug("Bootloader started\n");
    void* event_data;
    agent_event_t agent_event = bootloader_agent(&cfg, &event_data);
    if (IS_FAILURE(agent_event)) {
        log_debug("Bootloader error: %s\n", err_as_str(GET_ERROR(event_data)));
        // XXX handle this
    } else if (IS_CONTINUE(agent_event)) {
        if (agent_event == EVENT_BOOT) {
            log_debug("loading object\n");
            load_object(GET_BOOT_ID(event_data));
        }
    }
    // XXX I still need to manage the fatal errors
}
```

## CMakeLists.txt
```
cmake_minimum_required(VERSION 3.11)
include($ENV{ZEPHYR_BASE}/cmake/app/boilerplate.cmake NO_POLICY_SCOPE)
project(application)

target_sources(app PRIVATE src/runner.c)

set(ROOTDIR "../../..")

# Add libpull to the build
file(GLOB_RECURSE libpull_src ${ROOTDIR}/src/*.c)
file(GLOB libpull_headers ${ROOTDIR}/include)
target_sources(app PRIVATE ${libpull_src})
include_directories(${libpull_headers} ${ROOTDIR})

add_definitions(-DLOGGER_VERBOSITY=4)
add_definitions(-DMEMORY_FLASH_IMPL=1 -DSIMPLE_MANIFEST=1)
add_definitions(-DWITH_UPDATE_AGENT=1 -DWITH_CONNECTION_ZOAP=1)
add_definitions(-DWITH_PLATFORM_NRF52840=1)

set(TINYCRYPT 1) # TINYCRYPT or TINYDTLS or MBEDTLS
if (TINYCRYPT)
    add_definitions(-DWITH_TINYCRYPT=1)
elseif(TINYDTLS)
    add_definitions(-DWITH_TINYDTLS=1)
    include_directories(${ROOTDIR}/ext/tinydtls)
    file(GLOB ecc_src ${ROOTDIR}/ext/tinydtls/ecc/ecc.c)
    file(GLOB sha2_src ${ROOTDIR}/ext/tinydtls/sha2/sha2.c)
    file(GLOB crypto_src ${ROOTDIR}/ext/tinydtls/crypto.c)
    add_definitions(-DWITH_SHA256 -DSHA2_USE_INTTYPES_H)
    target_sources(app PRIVATE ${ecc_src} ${sha2_src} ${crypto_src})
elseif(MBEDTLS)
    add_definitions(-DWITH_MBEDTLS=1)
endif(TINYCRYPT)

# Add the board headers
include_directories(${ROOTDIR}/src/platform/nrf52840)
```

## prj.conf
```kconfig
CONFIG_CPLUSPLUS=y

CONFIG_DEBUG=y
CONFIG_STDOUT_CONSOLE=y

CONFIG_SYS_CLOCK_TICKS_PER_SEC=1000

CONFIG_BT=n

CONFIG_HAS_FLASH_LOAD_OFFSET=y
CONFIG_TEXT_SECTION_OFFSET=0x9100

CONFIG_MAIN_STACK_SIZE=2048

CONFIG_NETWORKING=y
CONFIG_ENTROPY_GENERATOR=y
CONFIG_ENTROPY_NRF5_RNG=y

CONFIG_NET_PKT_RX_COUNT=50
CONFIG_NET_PKT_TX_COUNT=50
CONFIG_NET_BUF_RX_COUNT=50
CONFIG_NET_BUF_TX_COUNT=50

CONFIG_NET_TX_STACK_SIZE=2048
CONFIG_NET_RX_STACK_SIZE=3072

CONFIG_NET_IPV4=n
CONFIG_NET_IPV6=y
CONFIG_NET_IF_UNICAST_IPV6_ADDR_COUNT=10
CONFIG_NET_IPV6_NBR_CACHE=n
CONFIG_NET_IPV6_MLD=n

CONFIG_REBOOT=y

CONFIG_NET_LOG=y
CONFIG_SYS_LOG_SHOW_COLOR=y
CONFIG_PRINTK=y

CONFIG_UART_INTERRUPT_DRIVEN=y

CONFIG_FLASH=y
CONFIG_FLASH_PAGE_LAYOUT=y
CONFIG_MPU_ALLOW_FLASH_WRITE=y

CONFIG_NET_L2_OPENTHREAD=y
CONFIG_OPENTHREAD_L2_DEBUG=y
CONFIG_OPENTHREAD_L2_LOG_LEVEL_INFO=y
CONFIG_OPENTHREAD_CHANNEL=13
CONFIG_IEEE802154_NRF5=y

CONFIG_TINYCRYPT=y
CONFIG_TINYCRYPT_SHA256=y
CONFIG_TINYCRYPT_ECC_DSA=y

CONFIG_NET_APP=y
CONFIG_NET_APP_NEED_IPV6=y
CONFIG_NET_APP_CLIENT=y
CONFIG_NET_APP_SETTINGS=y
CONFIG_NET_APP_MY_IPV6_ADDR="fd11:22::2"

CONFIG_NET_UDP=y
CONFIG_TEST_RANDOM_GENERATOR=y
CONFIG_COAP=y

CONFIG_SYS_LOG_NET_LEVEL=4
```

## prj_nrf52840_pca10056.conf
```kconfig
CONFIG_CPLUSPLUS=y

CONFIG_DEBUG=y
CONFIG_STDOUT_CONSOLE=y

CONFIG_SYS_CLOCK_TICKS_PER_SEC=1000

CONFIG_BT=n

CONFIG_HAS_FLASH_LOAD_OFFSET=y
CONFIG_TEXT_SECTION_OFFSET=0x9100

CONFIG_MAIN_STACK_SIZE=4096

CONFIG_NETWORKING=y
CONFIG_ENTROPY_GENERATOR=y
CONFIG_ENTROPY_NRF5_RNG=y

CONFIG_NET_PKT_RX_COUNT=10
CONFIG_NET_PKT_TX_COUNT=10
CONFIG_NET_BUF_RX_COUNT=10
CONFIG_NET_BUF_TX_COUNT=10

CONFIG_NET_TX_STACK_SIZE=2048
CONFIG_NET_RX_STACK_SIZE=3072

CONFIG_NET_IPV4=n
CONFIG_NET_IPV6=y
CONFIG_NET_IF_UNICAST_IPV6_ADDR_COUNT=10
CONFIG_NET_IPV6_NBR_CACHE=n
CONFIG_NET_IPV6_MLD=n

CONFIG_REBOOT=y

CONFIG_NET_LOG=n
CONFIG_SYS_LOG_SHOW_COLOR=n
CONFIG_PRINTK=n

CONFIG_UART_INTERRUPT_DRIVEN=y

CONFIG_FLASH=y
CONFIG_FLASH_PAGE_LAYOUT=y
CONFIG_MPU_ALLOW_FLASH_WRITE=y

CONFIG_NET_L2_OPENTHREAD=y
#CONFIG_OPENTHREAD_L2_DEBUG=n
#CONFIG_OPENTHREAD_L2_LOG_LEVEL_INFO=n
CONFIG_OPENTHREAD_CHANNEL=13
CONFIG_IEEE802154_NRF5=y

CONFIG_TINYCRYPT=y
CONFIG_TINYCRYPT_SHA256=y
CONFIG_TINYCRYPT_ECC_DSA=y

CONFIG_NET_APP=y
#CONFIG_NET_APP_NEED_IPV6=y
CONFIG_NET_APP_CLIENT=y
CONFIG_NET_APP_SETTINGS=y
CONFIG_NET_APP_MY_IPV6_ADDR="fd11:22::2"

CONFIG_NET_UDP=y
CONFIG_COAP=y
```

## src/runner.c
```c
#include <stdio.h>
#include <misc/reboot.h>
#include <libpull/common.h>
#include <libpull/security.h>

#include <libpull_agents/update.h>

#include "default_keys.h"

#define TIMEOUT 1000

#define SERVER_ADDR  "fd11:22::e43a:7c35:238a:c6cf"

#if WITH_TINYCRYPT
int default_CSPRNG(uint8_t *dest, unsigned int size) {
    return 0;
}
#endif

static agent_event_t agent_event;
static update_agent_config_t cfg;
static update_agent_ctx_t ctx;
static bool exitb = false;

int main(void) {
    conn_config_t conn;
    agent_data_t event_data;
    static char endpoint[] = SERVER_ADDR;
    conn_config(&conn, endpoint, 5683, PULL_UDP, NULL);

    update_agent_config(&cfg, &conn, &safestore_g);

    do {
        agent_event = update_agent(&cfg, &ctx, &event_data);
        if (IS_FAILURE(agent_event)) {
            log_debug("Failure\n");
            exitb = true;
            break;
        } else if (IS_SEND(agent_event)) {
            loop(GET_CONNECTION(agent_event), TIMEOUT);
        } else if (IS_CONTINUE(agent_event)) {
            if (agent_event == EVENT_APPLY) {
                log_debug("Success.. rebooting\n");
                sys_reboot(SYS_REBOOT_COLD);
                break;
            } else {
                log_debug("Continue..\n");
            }
        }
    } while (!exitb);
    log_debug("There was an error during the update phase\n");
    return 1;
}
```
